/*
   Neutron magpie dodeca:
   keyed LFO x 3
   3 LFOs on MIDI channel 1,2,3
   LFO frequency based on MIDI clock
   White notes are even dividers/multipliers black are odd
   each group of 4 outputs are thye same LFO with 90% phase shift.
   new notes will reset the LFO to whatever phase is set to.
   velocity will adjust the LFO amplitude
   4 CCs change parameters.
   CC_A change phase
   CC_B change waveform
   CC_C 
   CC_D
 * */
//

#include <MIDI.h>
//set the CCS to control LFO parameters //cirklon default CCs on new patterns are 1,4,6,10
const uint8_t CC_A = 1;//control phase
const uint8_t CC_B = 4;//control waveform
const uint8_t CC_C = 6;
const uint8_t CC_D = 10;

const uint8_t CHAN = 1;//set the first MIDI channel here! it will use the following 2 so dont go past 14, strange things might happen!
const uint8_t ISRrate = 25;
const uint32_t qPhase = 1073741824;//quarter of 32 bits accumulator
const uint32_t eCiel = 33554443; //32 bits / 128 for envelope cieling.

const uint8_t out2pin[] = {23, 0, 22, 25, 20, 6, 21, 5, 9, 4, 10, 3};//output number to actual teensy pin, dont change.
const uint8_t keyDivs[] = {4, 6 , 8, 12, 16, 32, 48, 64, 96, 128, 1, 2};//clock division for each key 4=1bar
const uint32_t rateScaler = 1636; //calculate this properly according to ISRrate when brain is working better

const int16_t sinTable[] = {
  0, 402, 804, 1206, 1607, 2009, 2410, 2811, 3211, 3611, 4011, 4409, 4807, 5205, 5601, 5997, 6392,
  6786, 7179, 7571, 7961, 8351, 8739, 9126, 9511, 9895, 10278, 10659, 11038, 11416, 11792, 12166, 12539,
  12909, 13278, 13645, 14009, 14372, 14732, 15090, 15446, 15799, 16150, 16499, 16845, 17189, 17530, 17868, 18204,
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  -5997, -5601, -5205, -4807, -4409, -4011, -3611, -3211, -2811, -2410, -2009, -1607, -1206, -804, -402,
};

const int16_t triTable[] = {
  0,
  255, 511, 767, 1023, 1279, 1535, 1791, 2047, 2303, 2559, 2815, 3071, 3327, 3584, 3839, 4095,
  4351, 4608, 4863, 5119, 5375, 5631, 5887, 6143, 6399, 6655, 6911, 7167, 7423, 7679, 7935, 8191,
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  -3839, -3584, -3327, -3071, -2815, -2559, -2303, -2047, -1791, -1535, -1279, -1023, -767, -511, -255,
};

const int16_t sqTable[] = {32767, -32767}; //table lengths will be calculated after pointer table

const int16_t FMTableSQR[]  = {

  1190, 4042, 6447, 8468, 9930, 10951, 11695, 12293, 12901, 13547, 14283, 15099, 15924, 16720, 17521, 18272,
  19019, 19712, 20356, 20935, 21456, 21886, 22256, 22570, 22844, 23090, 23316, 23504, 23676, 23846, 24019, 24214,
  24433, 24679, 24946, 25222, 25507, 25784, 26057, 26337, 26607, 26871, 27123, 27354, 27563, 27755, 27922, 28081,
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  -18383, -17633, -16839, -16040, -15223, -14398, -13651, -12990, -12382, -11784, -11079, -10096, -8726, -6761, -4441, -1602,
};

const int16_t *LFOpool[] = {sinTable, triTable, sqTable, FMTableSQR};
const int16_t *LFOsel1,*LFOsel2,*LFOsel3;

const uint16_t LFOselLen[] = {23,23,31,23}; //number of bits to shift the accumulator > wavetable
//they could be got automatically with sizeof, couldnt get it to work because of *LFOsel
uint8_t LFO_wavenum1=0,LFO_wavenum2=0,LFO_wavenum3=0;
uint8_t s1 = 23,s2 = 23,s3 = 23; //bitshifts for ISR 

uint32_t vel[3]; //velocity level
int32_t ENVworking[3];
int32_t env[3];
uint32_t ENVdecay[] = {2048383,2048383,2048383};
uint32_t ENVattack[] = {2048383,2048383,2048383};
bool ENVactive[3];
uint16_t INvert;

uint8_t pulses;
uint8_t per16th;
bool playing;
uint32_t MIDIclockRate;
float BPM;

uint16_t pitchOut;
uint32_t LFO_rate_mult[] = {4, 4, 4};
uint32_t intBPM;
uint8_t quarters;
uint8_t sixteenths;

struct oscillator1
{
  uint32_t phase = 0;
  uint32_t phaseA = 0;
  int32_t phaseRemain = 0;
  int32_t phaseOffset = 0;
  uint32_t phaseOld = 0;
  int32_t wave1;
  int32_t wave2;
  int32_t wave3;
  int32_t wave4;
  int32_t nextwave;  
  int32_t phase_increment = 0;
}
lfo1;

struct oscillator3
{
  uint32_t phase = 0;
  uint32_t phaseA = 0;
  int32_t phaseRemain = 0;
  int32_t phaseOffset = 0;
  uint32_t phaseOld = 0;
  int32_t wave1;
  int32_t wave2;
  int32_t wave3;
  int32_t wave4;
  int32_t phase_increment = 0;
}
lfo3;

struct oscillator2
{
  uint32_t phase = 0;
  uint32_t phaseA = 0;
  int32_t phaseRemain = 0;
  int32_t phaseOffset = 0;
  uint32_t phaseOld = 0;
  int32_t wave1;
  int32_t wave2;
  int32_t wave3;
  int32_t wave4;
  int32_t nextwave;
  int32_t phase_increment = 0;
}
lfo2;

//uint8_t cc2out[] = {40, 41, 42, 1, 44, 45, 46, 47, 48, 49, 50, 51};

//elapsedMicros waitPrint;
elapsedMillis MIDIclockRateIn;

IntervalTimer LFOtimer;

void outUpdateISR_LFOs(void);

void setup() {
  // Initiate MIDI communications, listen to all channels

  for (int i = 0; i < 12; i ++) {
    if (out2pin[i]) {
      pinMode(out2pin[i], OUTPUT);
      analogWriteFrequency(out2pin[i], 40000);
    }
  }

  analogWriteResolution(12);

  for (int i = 0; i < 12; i ++) {//start up LED animation
    for (int j = 0; j < 128; j ++) {
      if (out2pin[i] == 0) analogWrite(A14, (j<<5 ));
      else analogWrite(out2pin[i], j<<5 );
      delay(1);
    }
    if (out2pin[i] == 0) analogWrite(A14, 0);
    analogWrite(out2pin[i], 0);
  }//end of start up animantion

  MIDI.begin(MIDI_CHANNEL_OMNI);
  // Connect the Handlers to the library, so it is called upon reception.
  MIDI.setHandleNoteOn(HandleNoteOn);  // Put only the name of the function
  MIDI.setHandleControlChange(HandleControlChange);
  MIDI.setHandleNoteOff(HandleNoteOff);
  MIDI.setHandleClock(HandleClock);
  MIDI.setHandleStart(HandleStart);
  MIDI.setHandleStop(HandleStop);
  MIDI.setHandleContinue(HandleContinue);

  LFOtimer.begin(outUpdateISR_LFOs, ISRrate);
  
  LFOsel1= LFOsel2 = LFOsel3 = LFOpool[0];
//  Serial.begin(115200);
//  while (!Serial) {
//    ; // wait for serial port to connect. Needed for native USB
//  }
//  Serial.println("dodeca");  

}

void loop() {

  MIDI.read();

  DO_INCREMENTS();
  //Serial.println(lfo1.phase_increment);
}
